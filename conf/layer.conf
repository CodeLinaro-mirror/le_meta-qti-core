## conf/layer.conf
```bitbake
BBFILES += "${LAYERDIR}/recipes/*/*.bb ${LAYERDIR}/recipes/*/*.bbappend ${LAYERDIR}/recipes-*/*/*.bb ${LAYERDIR}/recipes-products/images/*.bbappend"
BBPATH .= ":${LAYERDIR}"
BBFILE_COLLECTIONS += "qti-core"
BBFILE_PRIORITY_qti-core = "12"
BBFILE_PATTERN_qti-core := "^${LAYERDIR}/"
UNPACKDIR ??= "${WORKDIR}"
LAYERSERIES_COMPAT_qti-core += "dunfell kirkstone scarthgap wrynose"
```
